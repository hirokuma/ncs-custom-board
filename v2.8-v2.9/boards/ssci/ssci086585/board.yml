## v2.8-v2.9/boards/ssci/ssci086585/board.yml
```yaml
board:
  name: ssci086585
  full_name: SSCI-086585
  vendor: ssci
  socs:
  - name: 'nrf5340'
    variants:
    - name: 'ns'
      cpucluster: 'cpuapp'
```
