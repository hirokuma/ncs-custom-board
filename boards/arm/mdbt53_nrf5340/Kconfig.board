## boards/arm/mdbt53_nrf5340/Kconfig.board
```kconfig
# MDBT53 NRF5340 board configuration

# Copyright (c) 2019-2020 Nordic Semiconductor ASA
# SPDX-License-Identifier: Apache-2.0

if SOC_NRF5340_CPUAPP_QKAA

config BOARD_MDBT53_NRF5340_CPUAPP
	bool "MDBT53 nRF5340 Application MCU"

config BOARD_MDBT53_NRF5340_CPUAPP_NS
	bool "MDBT53 nRF5340 Application MCU non-secure"

endif # SOC_NRF5340_CPUAPP_QKAA

config BOARD_MDBT53_NRF5340_CPUNET
	bool "MDBT53 NRF5340 Network MCU"
	depends on SOC_NRF5340_CPUNET_QKAA
```

## boards/arm/mdbt53_nrf5340/mdbt53_nrf5340_cpuapp_ns_defconfig
```kconfig
# SPDX-License-Identifier: Apache-2.0

CONFIG_SOC_SERIES_NRF53X=y
CONFIG_SOC_NRF5340_CPUAPP_QKAA=y
CONFIG_BOARD_MDBT53_NRF5340_CPUAPP_NS=y

# Enable MPU
CONFIG_ARM_MPU=y

# Enable hardware stack protection
CONFIG_HW_STACK_PROTECTION=y

# Enable TrustZone-M
CONFIG_ARM_TRUSTZONE_M=y

# This Board implies building Non-Secure firmware
CONFIG_TRUSTED_EXECUTION_NONSECURE=y

# enable GPIO
CONFIG_GPIO=y

# Enable uart driver
CONFIG_SERIAL=y

# enable console
CONFIG_CONSOLE=y
CONFIG_UART_CONSOLE=y

# For TF-M, MCUboot gets limited RAM. 
# However, for nRF5340 netcore update, it needs a lot of RAM.
# See Kconfig description for a security warning
CONFIG_MCUBOOT_USE_ALL_AVAILABLE_RAM=y
```

## boards/arm/ssci_mdbt53_dev_board/Kconfig.board
```kconfig
# SSCI MDBT53 Dev Board configuration

# Copyright (c) 2021 Nordic Semiconductor ASA
# SPDX-License-Identifier: Apache-2.0

if SOC_NRF5340_CPUAPP_QKAA

config BOARD_THINGY53_NRF5340_CPUAPP
	bool "SSCI MDBT53 Dev Board Application MCU"

config BOARD_THINGY53_NRF5340_CPUAPP_NS
	bool "SSCI MDBT53 Dev Board Application MCU non-secure"

endif # SOC_NRF5340_CPUAPP_QKAA

if SOC_NRF5340_CPUNET_QKAA

config BOARD_THINGY53_NRF5340_CPUNET
	bool "SSCI MDBT53 Dev Board Network MCU"

endif # SOC_NRF5340_CPUNET_QKAA
```

## boards/ssci/ssci086585/board.yml
```yaml
board:
  name: ssci086585
  vendor: ssci
  socs:
  - name: 'nrf5340'
    variants:
    - name: 'ns'
      cpucluster: 'cpuapp'
    - name: 'usb'
      cpucluster: 'cpuapp'
    - name: 'usb_ns'
      cpucluster: 'cpuapp'
```

## v2.7/boards/ssci/ssci086585/board.yml
```yaml
board:
  name: ssci086585
  vendor: ssci
  socs:
  - name: 'nrf5340'
    variants:
    - name: 'ns'
      cpucluster: 'cpuapp'
```
